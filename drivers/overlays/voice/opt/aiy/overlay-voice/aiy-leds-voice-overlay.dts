// Definitions for Google AIY LEDs
/dts-v1/;
/plugin/;
/ {
  compatible = "brcm,bcm2708";
  fragment@0 {
    target = <&i2c_arm>;
    __overlay__ {
      #address-cells = <1>;
      #size-cells = <0>;
      status = "okay";
      ktd2026@31 {
        compatible = "kinetic,ktd2026";
        reg = <0x31>;
        status = "okay";
      };
    };
  };
};
