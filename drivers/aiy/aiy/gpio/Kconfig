## drivers/aiy/aiy/gpio/Kconfig
```kconfig
menuconfig CONFIG_GPIO_AIY_IO
	tristate "AIY GPIO Support"
	help
	  Say Y here if you want to use AIY GPIO.

	  To compile this driver as a module, choose M here: the
	  module will be called gpio-aiy-io.
```

## drivers/aiy/aiy/iio/adc/Kconfig
```kconfig
menuconfig CONFIG_AIY_ADC
	tristate "AIY ADC Support"
	help
	  Say Y here if you want to use AIY ADC.

	  To compile this driver as a module, choose M here: the
	  module will be called aiy-adc.
```

## drivers/aiy/aiy/mfd/Kconfig
```kconfig
menuconfig CONFIG_AIY_IO_I2C
	tristate "AIY IO I2C Support"
	help
	  Say Y here if you want to use AIY IO I2C.

	  To compile this driver as a module, choose M here: the
	  module will be called aiy-io-i2c.
```

## drivers/aiy/aiy/pwm/Kconfig
```kconfig
menuconfig CONFIG_PWM_AIY_IO
	tristate "AIY PWM Support"
	help
	  Say Y here if you want to use AIY PWM.

	  To compile this driver as a module, choose M here: the
	  module will be called pwm-aiy-io.
```
